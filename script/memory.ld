MEMORY
{
  PROGRAM : ORIGIN = 0x00000000, LENGTH = 1M
  ROM     : ORIGIN = 0x10000000, LENGTH = 1M
  RAM     : ORIGIN = 0x20000000, LENGTH = 1M
}

pin_io = 0x30000000;

REGION_ALIAS("REGION_TEXT", PROGRAM);
REGION_ALIAS("REGION_RODATA", ROM);
REGION_ALIAS("REGION_DATA", RAM);
REGION_ALIAS("REGION_BSS", RAM);
REGION_ALIAS("REGION_HEAP", RAM);
REGION_ALIAS("REGION_STACK", RAM);
